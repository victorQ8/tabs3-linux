// SPDX-License-Identifier: BSD-3-Clause
/* Full Debian variant: GPU, audio DSP and modem, which all need this
 * tablet's own signed firmware, plus USB host mode. Keep the display-only
 * recovery independent of that firmware and bring-up. Stock SM-T825 reports
 * GPU chip ID 0x05030002; its signed a530_zap image lives in the apnhlos
 * partition, the ADSP, MBA and modem images in the modem partition.
 */
#include "msm8996-samsung-gts3llte-display.dts"

/* The display variant's list, with the codec reset (74) and interrupt (79),
 * the speaker amplifiers' I2C (47/48), primary TDM (65-68) and the stock
 * I2S switch enable (63) also released; package 56 also releases the
 * vibration motor (57, 120), the LTE grip sensor (81, 82, 132), the S Pen
 * (24, 34, 117, 126) and BLSP2 I2C6 (87, 88), the rear camera's MCLK0 (13),
 * reset (30) and core enable (9), the front camera's MCLK2 (15), reset (40)
 * and core enable (8), CCI (17-20), BLSP2 I2C1 (55, 56) and the USB-C
 * controller's BLSP1 I2C5 (83, 84) and interrupt (73).
 * TrustZone pins 25-28 and 58-61 stay reserved.
 */
&tlmm {
	gpio-reserved-ranges = <0 6>, <11 2>, <14 1>, <16 1>, <23 1>, <25 5>, <31 1>,
			       <38 2>, <49 2>, <53 2>, <58 5>, <69 4>, <75 4>, <80 1>,
			       <85 2>, <89 6>, <96 21>, <119 1>, <121 2>, <124 2>,
			       <127 5>, <133 10>, <144 6>;
};

#include "msm8996-samsung-gts3llte-adreno.dtsi"
#include "msm8996-samsung-gts3llte-carveouts.dtsi"
#include "msm8996-samsung-gts3llte-audio.dtsi"
#include "msm8996-samsung-gts3llte-modem.dtsi"
#include "msm8996-samsung-gts3llte-usb-host.dtsi"
#include "msm8996-samsung-gts3llte-sensors.dtsi"
#include "msm8996-samsung-gts3llte-haptics.dtsi"
#include "msm8996-samsung-gts3llte-video.dtsi"
#include "msm8996-samsung-gts3llte-platform.dtsi"
#include "msm8996-samsung-gts3llte-spen.dtsi"
#include "msm8996-samsung-gts3llte-camera.dtsi"
#include "msm8996-samsung-gts3llte-usbpd.dtsi"
#include "msm8996-samsung-gts3llte-usb3.dtsi"
#include "msm8996-samsung-gts3llte-flash.dtsi"

#include "msm8996-samsung-gts3llte-skin.dtsi"

/* Normal Debian only: qualified HS400 at an actual 192 MHz on this board.
 * Diagnostic/display/recovery variants retain the conservative 52 MHz cap.
 */
&sdhc1 {
	mmc-hs200-1_8v;
	mmc-hs400-1_8v;
	max-frequency = <200000000>;
};
